## xilinx-zc702-2025.2/project-spec/configs/rootfsconfigs/Kconfig.user
```kconfig
menu "user packages " 
config debug-tweaks  
	 bool "debug-tweaks"
	 help
	
config gpio-demo  
	 bool "gpio-demo"
	 help
	
config mydriver  
	 bool "mydriver"
	 help
	
config peekpoke  
	 bool "peekpoke"
	 help
	
endmenu
```
